## quirky/build-amd64/conf/local.conf
```bitbake
#
# This file is your local configuration file and is where all local user settings
# are placed. The comments in this file give some guide to the options a new user
# to the system might want to change but pretty much any configuration option can
# be set in this file. More adventurous users can look at local.conf.extended
# which contains other examples of configuration which can be placed in this file
# but new users likely won't need any of them initially.
#
# Lines starting with the '#' character are commented out and in some cases the
# default values are provided as comments to show people example syntax. Enabling
# the option is a question of removing the # character and making any change to the
# variable as required.

#
# Machine Selection
#
# You need to select a specific machine to target the build with. There are a selection
# of emulated machines available which can boot and run in the QEMU emulator:
#
#MACHINE ?= "qemuarm"
#MACHINE ?= "qemuarm64"
#MACHINE ?= "qemumips"
#MACHINE ?= "qemumips64"
#MACHINE ?= "qemuppc"
#MACHINE ?= "qemux86"
#MACHINE ?= "qemux86-64"
#
MACHINE ??= "genericx86-64"
DISTRO ?= "poky"

#
# Where to place downloads
#
# During a first build the system will download many different source code tarballs
# from various upstream projects. This can take a while, particularly if your network
# connection is slow. These are all stored in DL_DIR. When wiping and rebuilding you
# can preserve this directory to speed up this part of subsequent builds. This directory
# is safe to share between multiple builds on the same machine too.
#
# The default is a downloads directory under TOPDIR which is the build directory.
#
#DL_DIR ?= "${TOPDIR}/downloads"

#
# Where to place shared-state files
#
# BitBake has the capability to accelerate builds based on previously built output.
# This is done using "shared state" files which can be thought of as cache objects
# and this option determines where those files are placed.
#
# You can wipe out TMPDIR leaving this directory intact and the build would regenerate
# from these files if no changes were made to the configuration. If changes were made
# to the configuration, only shared state files where the state was still valid would
# be used (done using checksums).
#
# The default is a sstate-cache directory under TOPDIR.
#
#SSTATE_DIR ?= "${TOPDIR}/sstate-cache"

#
# Where to place the build output
#
# This option specifies where the bulk of the building work should be done and
# where BitBake should place its temporary files and output. Keep in mind that
# this includes the extraction and compilation of many applications and the toolchain
# which can use Gigabytes of hard disk space.
#
# The default is a tmp directory under TOPDIR.
#
#TMPDIR = "${TOPDIR}/tmp"


#
# Package Management configuration
#
# This variable lists which packaging formats to enable. Multiple package backends
# can be enabled at once and the first item listed in the variable will be used
# to generate the root filesystems.
# Options are:
#  - 'package_deb' for debian style deb files
#  - 'package_ipk' for ipk files are used by opkg (a debian style embedded package manager)
#  - 'package_rpm' for rpm style packages
# E.g.: PACKAGE_CLASSES ?= "package_rpm package_deb package_ipk"
# We default to ipk:
PACKAGE_CLASSES ?= "package_deb"

#
# SDK target architecture
#
# This variable specifies the architecture to build SDK items for and means
# you can build the SDK packages for architectures other than the machine you are
# running the build on (i.e. building i686 packages on an x86_64 host).
# Supported values are i686, x86_64, aarch64
#SDKMACHINE ?= "i686"

#
# Extra image configuration defaults
#
# The EXTRA_IMAGE_FEATURES variable allows extra packages to be added to the generated
# images. Some of these options are added to certain image types automatically. The
# variable can contain the following options:
#  "dbg-pkgs"       - add -dbg packages for all installed packages
#                     (adds symbol information for debugging/profiling)
#  "src-pkgs"       - add -src packages for all installed packages
#                     (adds source code for debugging)
#  "dev-pkgs"       - add -dev packages for all installed packages
#                     (useful if you want to develop against libs in the image)
#  "ptest-pkgs"     - add -ptest packages for all ptest-enabled packages
#                     (useful if you want to run the package test suites)
#  "tools-sdk"      - add development tools (gcc, make, pkgconfig etc.)
#  "tools-debug"    - add debugging tools (gdb, strace)
#  "eclipse-debug"  - add Eclipse remote debugging support
#  "tools-profile"  - add profiling tools (oprofile, lttng, valgrind)
#  "tools-testapps" - add useful testing tools (ts_print, aplay, arecord etc.)
#  "debug-tweaks"   - make an image suitable for development
#                     e.g. ssh root access has a blank password
# There are other application targets that can be used here too, see
# meta/classes/image.bbclass and meta/classes/core-image.bbclass for more details.
# We default to enabling the debugging tweaks.
#EXTRA_IMAGE_FEATURES ?= "debug-tweaks"
EXTRA_IMAGE_FEATURES ?= "debug-tweaks dev-pkgs tools-sdk"

#
# Additional image features
#
# The following is a list of additional classes to use when building images which
# enable extra features. Some available options which can be included in this variable
# are:
#   - 'buildstats' collect build statistics
USER_CLASSES ?= "buildstats"


#
# Runtime testing of images
#
# The build system can test booting virtual machine images under qemu (an emulator)
# after any root filesystems are created and run tests against those images. It can also
# run tests against any SDK that are built. To enable this uncomment these lines.
# See classes/test{image,sdk}.bbclass for further details.
#IMAGE_CLASSES += "testimage testsdk"
#TESTIMAGE_AUTO:qemuall = "1"

#
# Interactive shell configuration
#
# Under certain circumstances the system may need input from you and to do this it
# can launch an interactive shell. It needs to do this since the build is
# multithreaded and needs to be able to handle the case where more than one parallel
# process may require the user's attention. The default is iterate over the available
# terminal types to find one that works.
#
# Examples of the occasions this may happen are when resolving patches which cannot
# be applied, to use the devshell or the kernel menuconfig
#
# Supported values are auto, gnome, xfce, rxvt, screen, konsole (KDE 3.x only), none
# Note: currently, Konsole support only works for KDE 3.x due to the way
# newer Konsole versions behave
#OE_TERMINAL = "auto"
# By default disable interactive patch resolution (tasks will just fail instead):
PATCHRESOLVE = "noop"

#
# Disk Space Monitoring during the build
#
# Monitor the disk space during the build. If there is less that 1GB of space or less
# than 100K inodes in any key build location (TMPDIR, DL_DIR, SSTATE_DIR), gracefully
# shutdown the build. If there is less than 100MB or 1K inodes, perform a hard halt
# of the build. The reason for this is that running completely out of space can corrupt
# files and damages the build in ways which may not be easily recoverable.
# It's necessary to monitor /tmp, if there is no space left the build will fail
# with very exotic errors.
BB_DISKMON_DIRS ??= "\
    STOPTASKS,${TMPDIR},1G,100K \
    STOPTASKS,${DL_DIR},1G,100K \
    STOPTASKS,${SSTATE_DIR},1G,100K \
    STOPTASKS,/tmp,100M,100K \
    HALT,${TMPDIR},100M,1K \
    HALT,${DL_DIR},100M,1K \
    HALT,${SSTATE_DIR},100M,1K \
    HALT,/tmp,10M,1K"

#
# Shared-state files from other locations
#
# As mentioned above, shared state files are prebuilt cache data objects which can be
# used to accelerate build time. This variable can be used to configure the system
# to search other mirror locations for these objects before it builds the data itself.
#
# This can be a filesystem directory, or a remote url such as http or ftp. These
# would contain the sstate-cache results from previous builds (possibly from other
# machines). This variable works like fetcher MIRRORS/PREMIRRORS and points to the
# cache locations to check for the shared objects.
# NOTE: if the mirror uses the same structure as SSTATE_DIR, you need to add PATH
# at the end as shown in the examples below. This will be substituted with the
# correct path within the directory structure.
#SSTATE_MIRRORS ?= "\
#file://.* http://someserver.tld/share/sstate/PATH;downloadfilename=PATH \n \
#file://.* file:///some/local/dir/sstate/PATH"


#
# Qemu configuration
#
# By default qemu will build with a builtin VNC server where graphical output can be
# seen. The two lines below enable the SDL backend too. By default libsdl2-native will
# be built, if you want to use your host's libSDL instead of the minimal libsdl built
# by libsdl2-native then uncomment the ASSUME_PROVIDED line below.
PACKAGECONFIG:append:pn-qemu-system-native = " sdl"
PACKAGECONFIG:append:pn-nativesdk-qemu = " sdl"
#ASSUME_PROVIDED += "libsdl2-native"

#
# Hash Equivalence
#
# Enable support for automatically running a local hash equivalence server and
# instruct bitbake to use a hash equivalence aware signature generator. Hash
# equivalence improves reuse of sstate by detecting when a given sstate
# artifact can be reused as equivalent, even if the current task hash doesn't
# match the one that generated the artifact.
#
# A shared hash equivalent server can be set with "<HOSTNAME>:<PORT>" format
#
#BB_HASHSERVE = "auto"
#BB_SIGNATURE_HANDLER = "OEEquivHash"

#
# Memory Resident Bitbake
#
# Bitbake's server component can stay in memory after the UI for the current command
# has completed. This means subsequent commands can run faster since there is no need
# for bitbake to reload cache files and so on. Number is in seconds, after which the
# server will shut down.
#
#BB_SERVER_TIMEOUT = "60"

# CONF_VERSION is increased each time build/conf/ changes incompatibly and is used to
# track the version of this file when it was generated. This can safely be ignored if
# this doesn't mean anything to you.
CONF_VERSION = "2"

#20221130
# host running as root, causes heaps of these warnings...
WARN_QA:remove = "host-user-contaminated"
# get this with cups...
ERROR_QA:remove = "already-stripped"
WARN_QA:remove = "already-stripped"
# get this with cups...
WARN_QA:remove = "patch-fuzz"
# get this with libnss-mdns...
ERROR_QA:remove = "unknown-configure-option"
# my ghostscript...
ERROR_QA:remove = "ldflags"
# my polkit105...
ERROR_QA:remove = "installed-vs-shipped"

#20221203
# for vlc: dep 'mpeg2dec' requires commercial license. ditto ffmpeg
LICENSE_FLAGS_ACCEPTED += "commercial"

#20221205
#bring in stuff from dunfell...
# in yocto, got an error when building initramfs, default maxsize is too small.
# INITRAMFS_MAXSIZE is set in meta/conf/bitbake.conf (= 131072 kb, 128MB).
# override here, 160MB:
INITRAMFS_MAXSIZE = "163840"
# this is supposed to remove 'avahi' pkg...
DISTRO_FEATURES:remove = "zeroconf"
DISTRO_FEATURES:remove = "wayland"
DISTRO_FEATURES:remove = "systemd"
DISTRO_FEATURES_BACKFILL_CONSIDERED += "systemd"
DISTRO_FEATURES:remove = "ptest"
DISTRO_FEATURES:remove = "vulkan"
DISTRO_FEATURES:remove = "pcmcia"
DISTRO_FEATURES:remove = "multiarch"
#20221217... nah, leave it enabled...
#DISTRO_FEATURES:remove = "seccomp"
#current have:
# DISTRO_FEATURES_DEFAULT="acl alsa argp bluetooth debuginfod ext2 ipv4 ipv6 largefile pcmcia usbgadget usbhost wifi xattr nfs zeroconf pci 3g nfc x11 vfat seccomp"
DISTRO_FEATURES:append = " opengl ldconfig"

#20201220 my computer runs hot. defaults here are "-j 4" and "4"...
#20221217 threads 3 to 4, "-j 2" to "-j 4" (running on ryzen 5 laptop) NO LEAVE AS IS
PARALLEL_MAKE = "-j 2"
PARALLEL_MAKEINST = "-j 2"
BB_NUMBER_THREADS = "4"

PR = "r0"
#.bbappend recipes can use this to bump PR. ex: PR = "r${@int(PR_NUM) + 1}"
PR_NUM = "0"



###############################################################################
#20221130 pkg list before explicitly adding them here:
#acl acl-native apt-native attr attr-native autoconf autoconf-archive autoconf-archive-native autoconf-native automake automake-native base-files base-passwd bash bash-completion bc bc-native binutils binutils-cross-x86_64 bison-native bmap-tools-native btrfs-tools btrfs-tools-native busybox bzip2 bzip2-native ca-certificates ccache cdrtools-native cmake-native core-image-minimal coreutils coreutils-native cross-localedef-native curl curl-native cwautomacros-native db-native dbus debianutils-native depmodwrapper-cross diffstat diffutils docbook-xml-dtd4-native docbook-xsl-stylesheets-native dosfstools-native dpkg-native dwarfsrcfiles-native e2fsprogs e2fsprogs-native ed elfutils elfutils-native eudev expat expat-native file file-native findutils flex-native gawk gcc gcc-cross-x86_64 gcc-runtime gcc-sanitizers gcc-source-11.3.0 gdbm gdbm-native gettext gettext-minimal-native gettext-native glib-2.0 glib-2.0-native glibc glibc-locale gmp gmp-native gnome-desktop-testing gnu-config gnu-config-native gnu-efi gnutls gnutls-native gperf-native gptfdisk-native grep groff-native grub grub-bootconf grub-efi grub-native gtk-doc-native help2man-native init-ifupdown initscripts init-system-helpers intltool-native iproute2 iptables itstool-native kbd kern-tools-native keymaps kmod kmod-native ldconfig-native less libarchive libarchive-native libcap libcap-native libcap-ng libcap-ng-native libcroco liberror-perl libffi libffi-native libgcc libgcc-initial libgcrypt libgcrypt-native libgpg-error libgpg-error-native libice libidn2 libidn2-native libmicrohttpd libmicrohttpd-native libmnl libmpc libmpc-native libnsl2 libnsl2-native libpcre libpcre2-native libpcre-native libpthread-stubs libseccomp libsm libtirpc libtirpc-native libtool libtool-cross libtool-native libunistring libunistring-native libx11 libxau libxcb libxcrypt libxdmcp libxml2 libxml2-native libxml-parser-perl-native libxslt-native linux-libc-headers linux-yocto lua-native lz4-native lzip-native lzo lzo-native m4 m4-native make makedevs-native make-native mdadm meson-native modutils-initscripts mpfr mpfr-native mtools mtools-native nasm-native ncurses ncurses-native netbase nettle nettle-native ninja-native openssl openssl-native opkg-utils opkg-utils-native os-release packagegroup-core-boot packagegroup-core-buildessential packagegroup-core-sdk packagegroup-core-standalone-sdk-target parted-native patch patch-native perl perlcross-native perl-native pigz-native pkgconfig pkgconfig-native popt-native procps pseudo-native psmisc ptest-runner python3 python3-flit-core-native python3-installer-native python3-jinja2-native python3-markupsafe-native python3-native python3-setuptools-native python3-six-native python3-wheel-native qemu-native qemuwrapper-cross quilt quilt-native re2c-native readline readline-native rpm-native rsync-native run-postinsts sed shadow shadow-native shadow-securetty shadow-sysroot shared-mime-info shared-mime-info-native socat sqlite3 sqlite3-native squashfs-tools-native syslinux syslinux-native systemd-boot systemd-bootconf sysvinit sysvinit-inittab tcl tcl-native tcp-wrappers texinfo-dummy-native tzcode-native tzdata unifdef-native unzip unzip-native update-rc.d update-rc.d-native util-linux util-linux-libuuid util-linux-libuuid-native util-linux-native util-macros which xcb-proto xmlto-native xorgproto xorgproto-native xtrans xxhash-native xz xz-native zip zlib zlib-native zstd zstd-native

#20221130
IMAGE_INSTALL:append = " libreoffice epiphany"
#20221203
# inkscape fail: temp remove
IMAGE_INSTALL:append = " gimp gparted network-manager-applet ffmpeg mpv celluloid"
#xfce apps...
IMAGE_INSTALL:append = " xfce4-terminal parole"
#gnome apps... these require gtk4: gnome-desktop
#these require gnome-desktop: nautilus  ...changed dep to gnome-desktop3
IMAGE_INSTALL:append = " gedit gthumb ghex file-roller evince nautilus"
#qt apps...
IMAGE_INSTALL:append = " vlc"

#20221205 attempt to link rox-filer with older pango... 20221208 big fail!
#IMAGE_INSTALL:append = " pango-retro"

#20221204 recipes-quirky
# lidv fail... needed by lives and mjpegtools. lives is broken when run, 
# mjpegtools is a dep of lives, so have taken out these three...
# 'libgnomecanvas' fail: needed by planner, for now, take out 'planner' (which takes out both)...

#20221208 fail:  xf86-video-s3 xf86-video-tga xf86-video-glint
# ref: https://lists.x.org/archives/xorg-devel/2022-January/058800.html
#20221210 fail:  pekwm bogofilter
IMAGE_INSTALL:append = " adbfs arp-scan audacious audacious-plugins aumix awf bacon \
    bacon-hug bacon-hug-imports bbc-provided bbe bluepup-tray \
    bluez-tools brlaser ccrypt cddetect cddetect-quick celluloid \
    cgtkcalc claws-mail ctorrent curlftpfs dia dictd-client didiwiki disktype double-conversion \
    droidcam dvdauthor dvd-close dvd+rw-tools empty flsynclient fpm2 \
    freememapplet-tray frei0r galculator gccmakedep gcolorsel gdk-pixbuf-xlib gdl gdmap \
    gfnrename gfontsel gftp gif2lss gifsicle glipper-lite gmeasures gnet \
    gpart gphotofs gpicview gpptp grisbi gtk-chtheme gtkdialog gtkhash gtklp \
    gtk-vnc guvcview gview gwhere gxmessage hardinfo help2man helpsurfer hexchat \
    homebank hostname hotplug2stdout ifplugd ifplugd-old ijs imake inkscapelite \
    installwatch isomaster jimtcl jwm ktsuss leafpad libbluray libcddb \
    libetpan libexif-gtk libgd libglvnd libgtkhtml libmaa libofx libosinfo libpng12 \
    libsystem libtommath libtubo libvdpau-va-gl libvirt libvirt-glib libxaw3dxft \
    limine litehtml mdview metamail mhwaveedit minixcal mirdir \
    modem-stats mped mpscan mtpaint nbtscan nenscript netpbm network-tray nim \
    normalize notecase notification-daemon obexfs obs opensp osmo pa-applet \
    patchutils peasyscale-exec peasyscan-exec pflask picscale \
    pmcputemp pngoverlay-cairo pnmixer pnscan polkit105 powerapplet-tray \
    puppyinputdetect puppyserialdetect pup-tools recordmydesktop redshift refind \
    restarter retrovol rman rox-filer rubix sakura sane-backends scale2x scons \
    scrcpy setcolortemperature setvol sgml-common solvespace ssh-gui sshpass stat \
    ufiformat uget unclutter unicap unrar usbview vamps vcdimager vobcopy vym \
    wavplay whois wmctrl xarchive xcalc xclip xclipboard xconsole xcur2png \
    xdg-puppy xdialog xf86-video-amdgpu xf86-video-apm xf86-video-ark xf86-video-ast \
    xf86-video-chips xf86-video-i128 xf86-video-i740 xf86-video-mach64 \
    xf86-video-neomagic xf86-video-nv xf86-video-r128 xf86-video-rendition xf86-video-tdfx \
    xf86-video-trident xfdiff-cut xine-lib xine-ui xload xlockmore \
    xresprobe xsane xsoldier xvidcore xvidtune xvkbd yad0 yaf-splash"

#20221205 web server
#failed to fetch 'monkey'
# fail:  nginx
IMAGE_INSTALL:append = " apache2 hiawatha"
#ftp server
#install fail:  proftpd
IMAGE_INSTALL:append = " atftp pure-ftpd squid"
#ftp client
IMAGE_INSTALL:append = " ncftp"
#network utilities
# fail: netdata
IMAGE_INSTALL:append = " "
# rust for target fail, but rust libstd success (on dunfell)...
IMAGE_INSTALL:append = " libstd-rs"

#20221205 have a go...
IMAGE_INSTALL:append = " clang chromium-x11"
#fail...
#IMAGE_INSTALL:append = " firefox"


#########################################
#bring in more pkgs from dunfell...
#20221207 remove:  <<insists it wants pam. older version in dunfell was ok.
#  libidl <<config fail.   iotop-py <<compile fail.
IMAGE_INSTALL:append = " \
acpid ade alsa-plugins appstream-glib aufs-util \
bdftopcf bdwgc blueman bluez5 bridge-utils busybox-static \
cdrkit chrpath cifs-utils cryptodev-linux cups-filters \
desktop-file-utils dhcpcd dialog dmidecode dropbear efibootmgr efivar \
enca ethtool exfat-utils expect f2fs-tools fdk-aac fftw fltk freerdp \
fuse3 fuse-exfat gcab geany geany-plugins gflags giflib git glade \
glew glm glog gnome-common gnome-doc-utils-stub \
gnome-keyring gnome-menus gnupg gpgme gphoto2 graphite2 gsl gspell \
gstreamer1.0 gstreamer1.0-libav gstreamer1.0-plugins-bad \
gstreamer1.0-plugins-base gstreamer1.0-plugins-good gtkmm \
gtksourceview2 gtksourceview3 gutenprint gzip hdparm hplip hunspell \
hyphen ibus iceauth iftop imagemagick inotify-tools iw jack \
keyutils lemon libabw libao libart-lgpl libass libcamera libcanberra \
libcdio libcdr libcec libcgi-perl libcmis libdbd-mysql-perl \
libdbi-perl libdigest-sha1-perl libdvdcss libebml libe-book \
libeigen liberation-fonts libetonyek libexttextcat libfreehand libgee \
libgltf libgtop libhandy libhtml-parser-perl \
liblangtag libmatroska libmspub libmwaw libnet-ident-perl libnl \
libodfgen libpagemaker libpeas libplist libproxy librevenge libsass \
libsdl2-image libsdl2-mixer libsdl2-net libsdl2-ttf libsdl-gfx \
libsoup libssh libssh2 libtdb libtevent libunwind liburi-perl \
libusbmuxd libvisio libwpd libwpg libwps libxkbcommon libxklavier \
libxml-simple-perl libxres llvm lockdev lpsolve lsof luajit \
makedepend man-db mbedtls mdds-1.2 mdds-1.5 memtester mercurial \
mesa-demos mingetty minicom mkfontscale mlt mtr mythes neon netcat \
networkmanager nmap nodejs npth ntfs-3g-ntfsprogs ntp numlockx \
obexftp openal-soft opencv openldap openobex openssh orc p8platform \
packagegroup-core-x11 packagegroup-core-x11-xserver pavucontrol \
pciutils php pidgin pinentry pm-utils po4a portaudio-v19 potrace ppp \
pptp-linux pulseaudio python3-asn1crypto python3-cffi \
python3-cryptography python3-kiwisolver python3-lxml \
python3-matplotlib python3-numpy python3-pillow \
python3-pip python3-ply python3-prctl python3-pyqt5 \
python3-pyyaml pyxdg qpdf qt5-styleplugins qtbase qtdeclarative \
qtmultimedia qtquick3d qtquickcontrols qtquickcontrols2 \
qtquicktimeline qtscript qtsvg qttools qtwebsockets qtx11extras \
qtxmlpatterns quota raptor2 rasqal read-edid redland remmina rgb \
rng-tools rpcbind rpcsvc-proto rtorrent rxvt-unicode samba sassc \
scribus setserial setxkbmap sip3 slang smbnetfs sox sshfs-fuse \
streamripper subversion sudo swig sysfsutils tar tbb tigervnc tk \
unicode-ucd usb-modeswitch usb-modeswitch-data usbutils vala \
vim vorbis-tools vte vte9 wget wpa-supplicant wvdial wvstreams x11vnc \
xauth xcursorgen xdelta3 xdg-utils xdotool xdpyinfo xev \
xf86-input-evdev xf86-input-keyboard xf86-input-mouse \
xf86-input-synaptics xf86-input-wacom xf86-video-ati \
xf86-video-cirrus xf86-video-fbdev xf86-video-intel xf86-video-mga \
xf86-video-nouveau xf86-video-vesa xfontsel xgamma xhost xinit xinput \
xkbcomp xmessage xmodmap xorgxrdp xorriso xprop xrandr xrdb xrdp xset \
xsetmode xsetroot xterm xvinfo xwd xwininfo yad yajl yasm yelp \
yelp-tools yelp-xsl \
"

#20221207
#more python, in meta-python...
IMAGE_INSTALL:append = " \
python3-absl python3-aenum python3-aiofiles python3-aiohttp \
python3-aiohttp-jinja2 python3-aiohue python3-aiosignal python3-alembic \
python3-ansi2html python3-ansicolors python3-antlr4-runtime python3-appdirs \
python3-apply-defaults python3-argcomplete python3-argexec python3-argh \
python3-arpeggio python3-asciitree python3-aspectlib python3-astor \
python3-astroid python3-asttokens python3-asyncinotify python3-asyncio-glib \
python3-asyncio-throttle python3-async-timeout python3-attr python3-autobahn \
python3-automat python3-aws-iot-device-sdk-python python3-backcall \
python3-bandit python3-beautifulsoup4 python3-behave python3-betamax \
python3-bidict python3-bitarray python3-bitstring python3-bitstruct \
python3-blinker python3-booleanpy \
python3-cachecontrol python3-cached-property python3-cachetools python3-can \
python3-cantools python3-cassandra-driver python3-cbor2 python3-cchardet \
python3-cerberus python3-charset-normalizer python3-cheetah python3-click \
python3-click-repl python3-click-spinner python3-cmd2 python3-colorama \
python3-coloredlogs python3-colorlog python3-colorzero python3-configargparse \
python3-configobj python3-configshell-fb python3-constantly python3-contextlib2 \
python3-coverage python3-cppy python3-crc32c python3-crcmod python3-croniter \
python3-cson python3-custom-inherit python3-cycler \
python3-dateparser python3-dateutil python3-dbus-next python3-dbussy \
python3-decorator python3-defusedxml python3-deprecated python3-dill \
python3-diskcache python3-distro python3-django python3-djangorestframework \
python3-django-south python3-dnspython python3-docopt python3-dominate \
python3-dynamic-dispatch python3-ecdsa python3-editor python3-elementpath \
python3-email-validator python3-engineio python3-et-xmlfile python3-evdev \
python3-eventlet python3-execnet python3-fann2 python3-fasteners \
python3-fastjsonschema python3-fastnumbers python3-fields python3-flask \
python3-flask-babel python3-flask-bootstrap python3-flask-jsonpify \
python3-flask-jwt python3-flask-login python3-flask-mail python3-flask-migrate \
python3-flask-nav python3-flask-pymongo python3-flask-restful \
python3-flask-script python3-flask-sijax python3-flask-socketio \
python3-flask-sqlalchemy python3-flask-uploads python3-flask-user \
python3-flask-versioned python3-flask-wtf python3-flask-xstatic \
python3-frozenlist python3-future python3-gast python3-gcovr python3-geojson \
python3-geomet python3-gevent python3-gmpy2 python3-gmqtt python3-gnupg \
python3-google-api-core python3-google-api-python-client \
python3-googleapis-common-protos python3-google-auth python3-gpsd-py3 \
python3-graphviz python3-greenlet python3-greenstalk python3-grpcio \
python3-grpcio-tools python3-gsocketpool python3-gunicorn python3-h11 \
python3-h2 python3-h5py python3-haversine python3-hpack python3-html2text \
python3-html5lib python3-httplib2 python3-huey python3-humanfriendly \
python3-humanize python3-hyperframe python3-hyperlink python3-icu \
python3-idna-ssl python3-ifaddr python3-imageio python3-imgtool \
python3-incremental python3-inflection python3-intelhex python3-intervals \
python3-ipaddress python3-ipy python3-ipython python3-ipython-genutils \
python3-iso3166 python3-isodate python3-isort python3-itsdangerous \
python3-javaobj-py3 python3-jdatetime python3-jdcal python3-jedi \
python3-jmespath python3-joblib python3-jsmin python3-jsonpatch \
python3-jsonpath-rw python3-jsonref python3-jsonrpcserver python3-jstyleson \
python3-kconfiglib python3-keras-applications python3-keras-preprocessing \
python3-kivy python3-langtable python3-lazy-object-proxy \
python3-libconf python3-license-expression python3-lockfile python3-lorem \
python3-lrparsing python3-luma-core python3-luma-oled python3-lz4 \
python3-m2crypto python3-marshmallow \
python3-matplotlib-inline python3-mccabe python3-meh python3-meld3 python3-mock \
python3-monotonic python3-mpmath python3-msgpack python3-msk python3-msm \
python3-multidict python3-mypy python3-mypy-extensions python3-natsort \
python3-netaddr python3-netifaces python3-networkx python3-nmap \
python3-nocasedict python3-nocaselist python3-ntplib python3-oauthlib \
python3-obd python3-openpyxl python3-ordered-set python3-padaos \
python3-padatious python3-paho-mqtt python3-pako python3-pandas \
python3-parallax python3-paramiko python3-parse python3-parse-type \
python3-parso python3-passlib python3-pastedeploy python3-path \
python3-pathtools3 python3-pep8 python3-periphery python3-petact \
python3-pexpect python3-pickleshare python3-pid python3-pika \
python3-pint python3-pkcs11 python3-pkgconfig python3-pocketsphinx \
python3-polyline python3-portalocker python3-portion python3-posix-ipc \
python3-precise-runner python3-prettytable python3-priority \
python3-process-tests python3-progress python3-prompt-toolkit python3-protobuf \
python3-ptyprocess python3-pulsectl python3-pyalsaaudio python3-pyasn1-modules \
python3-pyatspi python3-pyaudio python3-pybind11 python3-pybind11-json \
python3-pybluez python3-pychromecast python3-pycocotools python3-pycodestyle \
python3-pyconnman python3-py-cpuinfo python3-pycurl python3-pydbus \
python3-pydbus-manager python3-pydicti python3-pydot python3-pyephem \
python3-pyexpect python3-pyfirmata python3-pyflakes python3-pyhamcrest \
python3-pyiface python3-pyinotify python3-pyjks python3-pyjwt \
python3-pykickstart python3-pykwalify python3-pylint python3-pylyrics \
python3-pymetno python3-pymisp python3-pymodbus python3-pymongo python3-pymysql \
python3-pynacl python3-pynetlinux python3-pyparted python3-pyperclip \
python3-pyperf python3-pyrad python3-pyro4 python3-pyroute2 python3-pyruvate \
python3-pyscaffold python3-pyserial python3-pyserial-asyncio python3-pysonos \
python3-pytest-asyncio python3-pytest-benchmark \
python3-pytest-cache python3-pytest-forked python3-pytest-helpers-namespace \
python3-pytest-html python3-pytest-lazy-fixture python3-pytest-metadata \
python3-pytest-tempdir python3-pytest-timeout python3-pytest-xdist \
python3-pythonping python3-python-vlc python3-pytoml python3-pytun \
python3-pytz-deprecation-shim python3-py-ubjson python3-pyudev python3-pyusb \
python3-pywbem python3-pywbemtools python3-pyzmq python3-qface python3-qrcode \
python3-raven python3-rdflib python3-redis python3-regex python3-requests-file \
python3-requests-ftp python3-requests-futures python3-requests-oauthlib \
python3-requests-toolbelt python3-robotframework \
python3-robotframework-seriallibrary python3-rsa python3-scrypt \
python3-sdnotify python3-semver python3-send2trash python3-sentry-sdk \
python3-serpent python3-sh python3-sijax python3-simpleeval python3-simplejson \
python3-slip-dbus python3-smbus python3-smbus2 python3-smpplib python3-snappy \
python3-socketio python3-soupsieve python3-speaklater python3-speedtest-cli \
python3-spidev python3-sqlalchemy python3-sqlparse python3-sqlsoup \
python3-stevedore python3-supervisor python3-sympy \
python3-tabulate python3-term python3-termcolor python3-textparser \
python3-texttable python3-thrift python3-tinyrecord python3-tornado \
python3-tqdm python3-trafaret python3-trafaret-config python3-traitlets \
python3-transitions python3-twine python3-twisted python3-twitter \
python3-twofish python3-txaio python3-txdbus python3-txws python3-typed-ast \
python3-typeguard python3-tzlocal python3-ujson python3-u-msgpack-python \
python3-unidiff python3-uritemplate python3-versiontools python3-visitor \
python3-waitress python3-watchdog python3-webencodings python3-websocket-client \
python3-websockets python3-werkzeug python3-whoosh python3-wpa-supplicant \
python3-wrapt python3-wtforms python3-wxgtk4 python3-xlrd python3-xlsxwriter \
python3-xmlrunner python3-xmlschema python3-xmltodict python3-xmodem \
python3-xstatic python3-xstatic-font-awesome python3-xxhash python3-yamlloader \
python3-yappi python3-yarl python3-zeroconf python3-zopeinterface \
"

#20221207 more python, in meta...
IMAGE_INSTALL:append = " \
python3-alabaster python3-async python3-atomicwrites \
python3-attrs python3-babel python3-bcrypt python3-certifi \
python3-chardet python3-cryptography-vectors \
python3-cython python3-dbus python3-dbusmock python3-docutils python3-dtschema \
python3-dtschema-wrapper python3-extras python3-flit-core python3-git \
python3-gitdb python3-hypothesis python3-idna python3-imagesize \
python3-importlib-metadata python3-iniconfig python3-iniparse python3-installer \
python3-iso8601 python3-jinja2 python3-jsonpointer python3-jsonschema \
python3-libarchive-c python3-magic python3-mako python3-markdown \
python3-markupsafe python3-more-itertools python3-ndg-httpsclient \
python3-packaging python3-pathlib2 python3-pbr python3-pluggy \
python3-poetry-core python3-pretend python3-psutil python3-py \
python3-pyasn1 python3-pycairo python3-pycparser python3-pycryptodome \
python3-pycryptodomex python3-pyelftools python3-pygments python3-pygobject \
python3-pyopenssl python3-pyparsing python3-pyrsistent python3-pysocks \
python3-pytest python3-pytest-runner python3-pytest-subtests python3-pytz \
python3-requests python3-rfc3339-validator \
python3-rfc3986-validator python3-rfc3987 python3-ruamel-yaml python3-scons \
python3-semantic-version python3-setuptools \
python3-setuptools-scm python3-six python3-smartypants python3-smmap \
python3-snowballstemmer python3-sortedcontainers python3-sphinx \
python3-sphinxcontrib-applehelp python3-sphinxcontrib-devhelp \
python3-sphinxcontrib-htmlhelp python3-sphinxcontrib-jsmath \
python3-sphinxcontrib-qthelp python3-sphinxcontrib-serializinghtml \
python3-sphinx-rtd-theme python3-strict-rfc3339 python3-subunit \
python3-testtools python3-toml python3-tomli python3-typing-extensions \
python3-typogrify python3-urllib3 python3-vcversioner python3-wcwidth \
python3-webcolors python3-wheel python3-zipp \
"

#20221211 more python, in meta-oe
IMAGE_INSTALL:append = " python3-distutils-extra python3-pycups"

#20221207 more perl, in meta-perl...
#20221209 fetch fail:  libcrypt-openssl-rsa-perl
IMAGE_INSTALL:append = " \
compress-raw-bzip2-perl compress-raw-lzma-perl compress-raw-zlib-perl \
libalgorithm-diff-perl libauthen-radius-perl libauthen-sasl-perl \
libcapture-tiny-perl libclass-method-modifiers-perl \
libconfig-autoconf-perl libcrypt-openssl-guess-perl \
libcrypt-openssl-random-perl libcurses-perl \
libdata-hexdump-perl libdbd-sqlite-perl libdevel-globaldestruction-perl \
libdigest-hmac-perl libencode-locale-perl libencode-perl \
libenv-perl libextutils-config-perl libextutils-cppguess-perl \
libextutils-helpers-perl libextutils-installpaths-perl libextutils-parsexs-perl \
libfile-slurper-perl libfile-slurp-perl libhtml-tagset-perl \
libhtml-tree-perl libimport-into-perl libio-compress-lzma-perl \
libio-compress-perl libio-socket-ssl-perl libio-stringy-perl libipc-signal-perl \
liblocale-gettext-perl libmime-charset-perl libmime-types-perl \
libmodule-build-tiny-perl libmodule-pluggable-perl libmodule-runtime-perl \
libmoo-perl libnet-dns-perl libnet-dns-sec-perl libnet-ldap-perl \
libnet-libidn-perl libnet-ssleay-perl libnet-telnet-perl libproc-waitstat-perl \
librole-tiny-perl libstrictures-perl libsub-exporter-progressive-perl \
libsub-uplevel-perl libterm-readkey-perl libtest-deep-perl libtest-harness-perl \
libtest-nowarnings-perl libtest-warnings-perl libtest-warn-perl \
libtext-charwidth-perl libtext-diff-perl libtext-iconv-perl \
libtext-wrapi18n-perl libunicode-linebreak-perl libxml-filter-buffertext-perl \
libxml-libxml-perl libxml-sax-writer-perl \
"

#20221207 more perl, in meta...
IMAGE_INSTALL:append = " \
libconvert-asn1-perl liberror-perl libmodule-build-perl libtest-needs-perl \
libtimedate-perl libxml-namespacesupport-perl libxml-parser-perl \
libxml-perl libxml-sax-base-perl libxml-sax-perl \
"

#20221211 more perl, in meta-oe
IMAGE_INSTALL:append = " \
libconfig-general-perl libdev-checklib-perl \
libfile-fnmatch-perl libio-pty-perl libjson-perl libparse-yapp-perl \
libperlio-gzip-perl"

#20221207 more libraries...
IMAGE_INSTALL:append = " wxwidgets gtk4"
#more utilities... remove: kern-tools
IMAGE_INSTALL:append = " archive-zip bc devilspie2 fontforge gnome-bluetooth3 \
   intltool ldconfig makedevs pigz re2c"
#more gnome/gtk apps...
IMAGE_INSTALL:append = " gnome-calculator gnome-calendar gnome-commander graphviz \
   surf"
#window etc...
IMAGE_INSTALL:append = " fvwm openbox obconf"
#dev...
IMAGE_INSTALL:append = " cmake meson"

#20221211 more from meta/recipes-devtools  remove:  mtd
IMAGE_INSTALL:append = " glide gptfdisk go nasm rsync ruby squashfs-tools \
    strace valgrind xmlto"
# more from meta-oe/recipes-devtools  remove: lapack octave (both need fortran)
IMAGE_INSTALL:append = " lshw ltrace memstat serialcheck"
# meta-networking/recipes-connectivity & meta-oe/recipes-connectivity
IMAGE_INSTALL:append = " firewalld ufw modemmanager transmission"

#20221217
IMAGE_INSTALL:append = " lmsensors lmsensors-config"

#20221222 last version using gtk2
IMAGE_INSTALL:append = " evince0"
#20221223
IMAGE_INSTALL:append = " inkscape"
IMAGE_INSTALL:append = " bison ed flex gperf iproute2 psmisc socat tzdata"
IMAGE_INSTALL:append = " zarfy"

#20221224
IMAGE_INSTALL:append = " lzip"
#20221225 removed mariadb dep from libreoffice, so add it back...
# rolled back to gnome-bluetooth3, which does not have upower & gsound deps, add back...
IMAGE_INSTALL:append = " mariadb upower gsound"

#20230123
IMAGE_INSTALL:append = " xloadimage"

#20230204
IMAGE_INSTALL:append = " gmime fbgrab gtkperf libforms libyui stalonetray \
    pointercal tslib xbindkeys xf86-input-tslib"
IMAGE_INSTALL:append = " leptonica tesseract-lang tesseract"

#20230217
IMAGE_INSTALL:append = " xf86-video-s3virge"
```
